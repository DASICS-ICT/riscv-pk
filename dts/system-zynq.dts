/dts-v1/;

/ {
	#address-cells = <2>;
	#size-cells = <2>;
	compatible = "freechips,rocketchip-unknown-dev";
	model = "freechips,rocketchip-unknown";
	
	aliases {
		serial0 = &L14;
	};

	chosen {
		bootargs = "root=/dev/mmcblk0p2 rootfstype=ext4 rw rootwait earlycon";
		stdout-path = "serial0";
	};
	
	L19: cpus {
		#address-cells = <1>;
		#size-cells = <0>;
		timebase-frequency = <1000000>;
		L6: cpu@0 {
			clock-frequency = <0>;
			compatible = "UCAS,COOSCA1.0", "riscv";
			d-cache-block-size = <64>;
			d-cache-sets = <64>;
			d-cache-size = <16384>;
			d-tlb-sets = <1>;
			d-tlb-size = <32>;
			device_type = "cpu";
			i-cache-block-size = <64>;
			i-cache-sets = <64>;
			i-cache-size = <16384>;
			i-tlb-sets = <1>;
			i-tlb-size = <32>;
			mmu-type = "riscv,sv39";
			next-level-cache = <&L11>;
			reg = <0x0>;
			riscv,isa = "rv64imafdc";
			status = "okay";
			timebase-frequency = <1000000>;
			tlb-split;
			L4: interrupt-controller {
				#interrupt-cells = <1>;
				compatible = "riscv,cpu-intc";
				interrupt-controller;
			};
		};
	};

	
	L18: soc {
		#address-cells = <2>;
		#size-cells = <2>;
		compatible = "freechips,rocketchip-unknown-soc", "simple-bus";
		ranges;
		// PLIC: interrupt-controller@3c000000 {
		// 		#interrupt-cells = <1>;
		// 		compatible = "riscv,plic0";
		// 		interrupt-controller;
		// 		interrupts-extended = <&L4 11 &L4 9>; // <- problem?
		// 		//reg = <0 0xc000000 0 0x4000000>;
		// 		reg = <0 0x3c000000 0 0x4000000>;
		// 		reg-names = "control";
		// 		riscv,max-priority = <7>;
		// 		riscv,ndev = <64>;
		// 	};
		L3: debug-controller@0 {
			compatible = "sifive,debug-013", "riscv,debug-013";
			/* interrupts-extended = <&L4 65535>; */
			reg = <0x0 0x0 0x0 0x1000>;
			reg-names = "control";
		};
		L2: clint@2000000 {
			compatible = "riscv,clint0";
			interrupts-extended = <&L4 3 &L4 7>;
			reg = <0x0 0x48000000 0x0 0x10000>;
			reg-names = "control";
      		clock-frequency-mhz = <60>
		};
		L14: serial@60000000 {
      		compatible = "xlnx,xuartps", "cdns,uart-r1p8";
			//interrupt-parent = <&L1>;
			//interrupts = <3>;
			reg = <0x0 0x40000000 0x0 0x1000>;
			reg-names = "control";
		};
		L1: interrupt-controller@c000000 {
			#interrupt-cells = <1>;
			compatible = "riscv,plic0";
			interrupt-controller;
			interrupts-extended = <&L4 9>;
			reg = <0x0 0x4c000000 0x0 0x4000000>;
			reg-names = "control";
			riscv,max-priority = <7>;
			riscv,ndev = <1>;
		};
		//L10: external-interrupts {
		//	interrupt-parent = <&L1>;
		//	interrupts = <1>;
		//};
		sdhci0: mmc@E0100000 {
			compatible = "arasan,sdhci-8.9a";
			clock-names = "clk_xin", "clk_ahb";
			clocks = <&L13 21>, <&L13 32>;
			interrupt-parent = <&L1>;
			interrupts = <1>;
			reg = <0x0 0x40100000 0x0 0x1000>;
		};
		L12: slcr@F8000000 {
			u-boot,dm-pre-reloc;
			#address-cells = <1>;
			#size-cells = <1>;
			compatible = "xlnx,zynq-slcr", "syscon", "simple-mfd";
			reg = <0x0 0x41000000 0x0 0x1000>;
			ranges;
			L13: clkc {
				u-boot,dm-pre-reloc;
				#clock-cells = <1>;
				compatible = "xlnx,ps7-clkc";
				fclk-enable = <0xf>;
				clock-output-names = "armpll", "ddrpll", "iopll", "cpu_6or4x",
						"cpu_3or2x", "cpu_2x", "cpu_1x", "ddr2x", "ddr3x",
						"dci", "lqspi", "smc", "pcap", "gem0", "gem1",
						"fclk0", "fclk1", "fclk2", "fclk3", "can0", "can1",
						"sdio0", "sdio1", "uart0", "uart1", "spi0", "spi1",
						"dma", "usb0_aper", "usb1_aper", "gem0_aper",
						"gem1_aper", "sdio0_aper", "sdio1_aper",
						"spi0_aper", "spi1_aper", "can0_aper", "can1_aper",
						"i2c0_aper", "i2c1_aper", "uart0_aper", "uart1_aper",
						"gpio_aper", "lqspi_aper", "smc_aper", "swdt",
						"dbg_trc", "dbg_apb";
				reg = <0x100 0x100>;
				ps-clk-frequency = <50000000>;
			};
		};
	};
	L11: memory@100000000 {
		device_type = "memory";
		reg = <0x0 0x80000000 0x0 0x10000000>;
	};
};
